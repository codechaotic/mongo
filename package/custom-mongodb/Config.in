## package/custom-mongodb/Config.in
```kconfig
config BR2_PACKAGE_CUSTOM_MONGODB
        bool "custom-mongodb"
        depends on BR2_TOOLCHAIN_EXTERNAL_CUSTOM_GLIBC || BR2_TOOLCHAIN_BUILDROOT_GLIBC
        depends on BR2_TOOLCHAIN_EXTERNAL_CXX || BR2_TOOLCHAIN_BUILDROOT_CXX
        help
          A highly scalable object storage service

          https://github.com/mongodb/mongo

comment "MongoDB requires a glibc toolchain with C++ support"
	depends on !(BR2_TOOLCHAIN_BUILDROOT_CXX || BR2_TOOLCHAIN_BUILDROOT_GLIBC)
  depends on !(BR2_TOOLCHAIN_EXTERNAL_CXX || BR2_TOOLCHAIN_EXTERNAL_CUSTOM_GLIBC)

menu "MongoDB Options"
        depends on BR2_PACKAGE_CUSTOM_MONGODB

config BR2_PACKAGE_CUSTOM_MONGODB_SSL
        bool "ssl-support"
        depends on BR2_PACKAGE_OPENSSL

comment "OpenSSL library required to build with SSL support"
	depends on !BR2_PACKAGE_OPENSSL

config BR2_PACKAGE_CUSTOM_MONGODB_MONGO
        bool "mongo"
        depends on BR2_PACKAGE_CUSTOM_MONGODB

config BR2_PACKAGE_CUSTOM_MONGODB_MONGOD
        bool "mongod"
        depends on BR2_PACKAGE_CUSTOM_MONGODB

config BR2_PACKAGE_CUSTOM_MONGODB_MONGOS
        bool "mongos"
        depends on BR2_PACKAGE_CUSTOM_MONGODB

endmenu
```

## package/mongodb/Config.in
```kconfig
config BR2_PACKAGE_MONGODB
        bool "mongodb"
        depends on BR2_TOOLCHAIN_EXTERNAL_CUSTOM_GLIBC || BR2_TOOLCHAIN_BUILDROOT_GLIBC
        depends on BR2_TOOLCHAIN_EXTERNAL_CXX || BR2_TOOLCHAIN_BUILDROOT_CXX
        help
          A highly scalable object storage service

          https://github.com/mongodb/mongo

comment "MongoDB requires a glibc toolchain with C++ support"
	depends on !(BR2_TOOLCHAIN_BUILDROOT_CXX || BR2_TOOLCHAIN_BUILDROOT_GLIBC)
  depends on !(BR2_TOOLCHAIN_EXTERNAL_CXX || BR2_TOOLCHAIN_EXTERNAL_CUSTOM_GLIBC)

menu "MongoDB Options"
        depends on BR2_PACKAGE_MONGODB

config BR2_PACKAGE_MONGODB_SSL
        bool "ssl-support"
        depends on BR2_PACKAGE_OPENSSL

comment "OpenSSL library required to build with SSL support"
	depends on !BR2_PACKAGE_OPENSSL

config BR2_PACKAGE_MONGODB_MONGO
        bool "mongo"
        depends on BR2_PACKAGE_MONGODB

config BR2_PACKAGE_MONGODB_MONGOD
        bool "mongod"
        depends on BR2_PACKAGE_MONGODB

config BR2_PACKAGE_MONGODB_MONGOS
        bool "mongos"
        depends on BR2_PACKAGE_MONGODB

config BR2_PACKAGE_MONGODB_MONGOPERF
        bool "mongoperf"
        depends on BR2_PACKAGE_MONGODB

endmenu
```

## project-default/defconfig
```kconfig
BR2_x86_64=y
BR2_DL_DIR="$(BR2_EXTERNAL)/dl"
BR2_PACKAGE_OVERRIDE_FILE="$(BR2_EXTERNAL)/local.mk"
BR2_GLOBAL_PATCH_DIR="$(BR2_EXTERNAL)/patch"
BR2_TOOLCHAIN_EXTERNAL=y
BR2_TOOLCHAIN_EXTERNAL_CUSTOM=y
BR2_TOOLCHAIN_EXTERNAL_PATH="$(BR2_EXTERNAL)/project-toolchain/output/host/usr"
BR2_TOOLCHAIN_EXTERNAL_HEADERS_4_0=y
BR2_TOOLCHAIN_EXTERNAL_CUSTOM_GLIBC=y
BR2_TOOLCHAIN_EXTERNAL_CXX=y
BR2_ROOTFS_OVERLAY="$(BR2_EXTERNAL)/overlay"
BR2_PACKAGE_OPENSSL=y
BR2_PACKAGE_MONGODB=y
BR2_PACKAGE_MONGODB_SSL=y
BR2_PACKAGE_MONGODB_MONGO=y
BR2_PACKAGE_MONGODB_MONGOD=y
BR2_PACKAGE_MONGODB_MONGOS=y
BR2_PACKAGE_MONGODB_MONGOPERF=y
```

## project-toolchain/defconfig
```kconfig
BR2_x86_64=y
BR2_DL_DIR="$(BR2_EXTERNAL)/dl"
BR2_PACKAGE_OVERRIDE_FILE="$(BR2_EXTERNAL)/local.mk"
BR2_GLOBAL_PATCH_DIR="$(BR2_EXTERNAL)/patch"
BR2_TOOLCHAIN_BUILDROOT_GLIBC=y
BR2_TOOLCHAIN_BUILDROOT_CXX=y
BR2_INIT_NONE=y
BR2_ROOTFS_OVERLAY="$(BR2_EXTERNAL)/overlay"
# BR2_PACKAGE_BUSYBOX is not set
# BR2_TARGET_ROOTFS_TAR is not set
```

## project/mongo-3.2/defconfig
```kconfig
BR2_x86_64=y
BR2_CCACHE=y
BR2_TOOLCHAIN_EXTERNAL=y
BR2_TOOLCHAIN_EXTERNAL_CUSTOM=y
BR2_TOOLCHAIN_EXTERNAL_PATH="$(BR2_EXTERNAL_BUILDROOT_SUBMODULE_PATH)/project/toolchain/output/host/usr"
BR2_TOOLCHAIN_EXTERNAL_GCC_5=y
BR2_TOOLCHAIN_EXTERNAL_HEADERS_3_2=y
BR2_TOOLCHAIN_EXTERNAL_CUSTOM_GLIBC=y
BR2_TOOLCHAIN_EXTERNAL_CXX=y
BR2_TARGET_GENERIC_HOSTNAME="mongo"
BR2_TARGET_GENERIC_ISSUE="MongoDB"
BR2_PACKAGE_OPENSSL=y
BR2_PACKAGE_NUMACTL=y
BR2_PACKAGE_MONGO=y
BR2_PACKAGE_MONGO_3_2=y
BR2_PACKAGE_MONGO_SSL=y
BR2_PACKAGE_MONGO_MONGOD=y
BR2_PACKAGE_MONGO_MONGOS=y
BR2_ROOTFS_OVERLAY="$(BR2_EXTERNAL_BUILDROOT_SUBMODULE_PATH)/overlay/3.2"
```

## project/toolchain/defconfig
```kconfig
BR2_x86_64=y
BR2_TOOLCHAIN_BUILDROOT_GLIBC=y
BR2_KERNEL_HEADERS_3_2=y
BR2_TOOLCHAIN_BUILDROOT_CXX=y
BR2_INIT_NONE=y
```

## src/Config.in
```kconfig
# make the variant name available as a Config.in variable
source "$BR2_EXTERNAL_SRC_PATH/package/mongo/Config.in"
```

## src/package/mongo/Config.in
```kconfig
config BR2_PACKAGE_MONGO
        bool "mongo"
        depends on BR2_TOOLCHAIN_EXTERNAL_CUSTOM_GLIBC || BR2_TOOLCHAIN_BUILDROOT_GLIBC
        depends on BR2_TOOLCHAIN_EXTERNAL_CXX || BR2_TOOLCHAIN_BUILDROOT_CXX
        help
          A highly scalable object storage service

          https://github.com/mongodb/mongo

comment "MongoDB requires a glibc toolchain with C++ support"
	depends on !(BR2_TOOLCHAIN_BUILDROOT_CXX || BR2_TOOLCHAIN_BUILDROOT_GLIBC)
  depends on !(BR2_TOOLCHAIN_EXTERNAL_CXX || BR2_TOOLCHAIN_EXTERNAL_CUSTOM_GLIBC)

menu "Build Options for MongoDB"
        depends on BR2_PACKAGE_MONGO

choice
  prompt: "version"
  default BR2_PACKAGE_MONGO_3_4
  config BR2_PACKAGE_MONGO_3_0
          bool "3.0"
          depends on BR2_PACKAGE_MONGO

  config BR2_PACKAGE_MONGO_3_2
          bool "3.2"
          depends on BR2_PACKAGE_MONGO

  config BR2_PACKAGE_MONGO_3_4
          bool "3.4"
          depends on BR2_PACKAGE_MONGO

  config BR2_PACKAGE_MONGO_3_5
          bool "3.5"
          depends on BR2_PACKAGE_MONGO

endchoice

config BR2_PACKAGE_MONGO_SSL
        bool "ssl-support"
        depends on BR2_PACKAGE_OPENSSL
        depends on BR2_PACKAGE_MONGO

comment "OpenSSL library required to build with SSL support"
	depends on !BR2_PACKAGE_OPENSSL

config BR2_PACKAGE_MONGO_MONGO
        bool "mongo"
        depends on BR2_PACKAGE_MONGO

config BR2_PACKAGE_MONGO_MONGOD
        bool "mongod"
        depends on BR2_PACKAGE_MONGO

config BR2_PACKAGE_MONGO_MONGOS
        bool "mongos"
        depends on BR2_PACKAGE_MONGO

endmenu
```

## src/project/3.0/defconfig
```kconfig
BR2_x86_64=y
BR2_CCACHE=y
BR2_TOOLCHAIN_EXTERNAL=y
BR2_TOOLCHAIN_EXTERNAL_CUSTOM=y
BR2_TOOLCHAIN_EXTERNAL_PATH="$(TOOLCHAIN)"
BR2_TOOLCHAIN_EXTERNAL_GCC_5=y
BR2_TOOLCHAIN_EXTERNAL_HEADERS_3_2=y
BR2_TOOLCHAIN_EXTERNAL_CUSTOM_GLIBC=y
BR2_TOOLCHAIN_EXTERNAL_CXX=y
BR2_TARGET_GENERIC_HOSTNAME="mongo"
BR2_TARGET_GENERIC_ISSUE="MongoDB"
BR2_PACKAGE_OPENSSL=y
BR2_PACKAGE_NUMACTL=y
BR2_PACKAGE_MONGO=y
BR2_PACKAGE_MONGO_3_0=y
BR2_PACKAGE_MONGO_SSL=y
BR2_PACKAGE_MONGO_MONGOD=y
BR2_PACKAGE_MONGO_MONGOS=y
```

## src/project/3.5/defconfig
```kconfig
BR2_x86_64=y
BR2_CCACHE=y
BR2_GLOBAL_PATCH_DIR="$(BR2_EXTERNAL_SRC_PATH)/patch"
BR2_TOOLCHAIN_EXTERNAL=y
BR2_TOOLCHAIN_EXTERNAL_CUSTOM=y
BR2_TOOLCHAIN_EXTERNAL_PATH="$(TOOLCHAIN)"
BR2_TOOLCHAIN_EXTERNAL_GCC_5=y
BR2_TOOLCHAIN_EXTERNAL_HEADERS_3_2=y
BR2_TOOLCHAIN_EXTERNAL_CUSTOM_GLIBC=y
BR2_TOOLCHAIN_EXTERNAL_CXX=y
BR2_TARGET_GENERIC_HOSTNAME="mongo"
BR2_TARGET_GENERIC_ISSUE="MongoDB"
BR2_ROOTFS_OVERLAY="$(BR2_EXTERNAL_SRC_PATH)/overlay/$(PROJECT)"
BR2_PACKAGE_OPENSSL=y
BR2_PACKAGE_NUMACTL=y
BR2_PACKAGE_MONGO=y
BR2_PACKAGE_MONGO_3_5=y
BR2_PACKAGE_MONGO_SSL=y
BR2_PACKAGE_MONGO_MONGOD=y
BR2_PACKAGE_MONGO_MONGOS=y
```
